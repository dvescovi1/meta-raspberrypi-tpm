## conf/layer.conf
```bitbake
# We have a conf and classes directory, add to BBPATH
BBPATH .= ":${LAYERDIR}"

# We have a recipes-* directories, add to BBFILES
BBFILES += "${LAYERDIR}/recipes-*/*/*.bb \
	${LAYERDIR}/recipes-*/*/*.bbappend"

BBFILE_COLLECTIONS += "raspberrypi-tpm"
BBFILE_PATTERN_raspberrypi-tpm = "^${LAYERDIR}/"
BBFILE_PRIORITY_raspberrypi-tpm = "10"
LAYERVERSION_raspberrypi-tpm = "1"
LAYERSERIES_COMPAT_raspberrypi-tpm = "dunfell"
```
